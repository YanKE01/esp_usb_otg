## main/Kconfig
```kconfig
menu "Board Select"
    config ESP32_S3_USB_OTG
        bool "ESP32-S3-USB-OTG"
    
    config ESP32_S3_EYE
        bool "ESP32-EYE"
        depends on !ESP32-S3-USB-OTG

endmenu
```

## sdkconfig.defaults
```kconfig
CONFIG_PARTITION_TABLE_CUSTOM=y
CONFIG_PARTITION_TABLE_CUSTOM_FILENAME="partitions.csv"
CONFIG_PARTITION_TABLE_FILENAME="partitions.csv"
CONFIG_TINYUSB_HID_COUNT=1
CONFIG_LV_COLOR_16_SWAP=y
CONFIG_TINYUSB_MSC_ENABLED=y

CONFIG_ESP32S3_DEFAULT_CPU_FREQ_240=y
CONFIG_ESP32S3_SPIRAM_SUPPORT=y
CONFIG_SPIRAM_SPEED_80M=y
CONFIG_SPIRAM_MODE_OCT=y
```
